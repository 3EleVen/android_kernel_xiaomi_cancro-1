## arch/arm/hotplug/Kconfig
```kconfig
config INTELLI_PLUG
        bool "Enable intelli-plug cpu hotplug driver"
        default n
        help
          Generic Intelli-plug cpu hotplug driver for ARM SOCs

config ALUCARD_HOTPLUG
	bool "Enable alucard-hotplug cpu hotplug driver"
	default n
	help
	  Generic Alucard-hotplug cpu hotplug driver for ARM SOCs

config AUTOSMP
	bool "AutoSMP Hotplug"
	depends on SMP && HOTPLUG_CPU
	help
	  Automatically hotplugs the multiple CPU cores based on
	  CPU load and suspend state.
```
